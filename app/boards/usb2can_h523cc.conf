## app/boards/usb2can_h523cc.conf
```kconfig
# NodeMotorsport USB branding
CONFIG_CANNECTIVITY_USB_MANUFACTURER="NodeMotorsport"
CONFIG_CANNECTIVITY_USB_PRODUCT="NodeMotorsport USB2CANFD"

# CAN FD support
CONFIG_CAN=y
CONFIG_CAN_FD_MODE=y

# SWO logging (keep your existing debug settings)
CONFIG_LOG=y
CONFIG_LOG_BACKEND_SWO=y

# Enable GPIO-controlled CAN termination
CONFIG_CANNECTIVITY_TERMINATION_GPIO=y

# Termination OFF after boot
CONFIG_CANNECTIVITY_TERMINATION_DEFAULT_ON=n
```
